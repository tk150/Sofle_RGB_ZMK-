// 禁用右手原有的编码器
&right_encoder {
    status = "disabled";
};

// 在根节点下添加新的摇杆设备
/ {
    joystick: joystick {
        compatible = "adc-joystick";
        label = "JOYSTICK";
        io-channels = <&adc 4>, <&adc 5>; // 对应 AIN4(P0.28) 和 AIN5(P0.29)
        #io-channel-cells = <1>;
        x-input = <&adc 5>; // VRy -> AIN5 (P0.29, 原编码器A脚)
        y-input = <&adc 4>; // VRx -> AIN4 (P0.28, 原编码器B脚)
        // 如果需要使用摇杆的下按功能(SW)，请取消注释并修改引脚号X
       sw-gpios = <&pro_micro 10 (GPIO_ACTIVE_LOW | GPIO_PULL_UP)>;
    };
};
